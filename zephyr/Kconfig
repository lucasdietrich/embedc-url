## zephyr/Kconfig
```kconfig
menuconfig EMBEDC_URL_PARSER
        bool "embedc-url - Utilities for URL parsing"
        default n
        help
          Enable support for embedc-url library

if EMBEDC_URL_PARSER

module = EMBEDC_URL_PARSER
module-str = EMBEDC_URL_PARSER

config EMBEDC_URL_PARSER_ITER_MAX_DEPTH
		int "Maximum depth of routes iterator"
		default 10
		help
		  Maximum depth of routes iterator
endif
```
